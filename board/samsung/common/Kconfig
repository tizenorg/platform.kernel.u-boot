## board/samsung/common/Kconfig
```kconfig
if TARGET_TIZEN

config SYS_BOARD
	default "common"

config SYS_VENDOR
	default "samsung"

config SYS_CONFIG_NAME
	default "tizen"

endif
```

## board/samsung/draco/Kconfig
```kconfig
if TARGET_SAMSUNG_DRACO

config SYS_BOARD
	default "draco"

config SYS_VENDOR
	default "samsung"

config SYS_SOC
	default "exynos5433"

config SYS_CONFIG_NAME
	default "samsung_draco"

endif
```

## board/samsung/odroid-xu3/Kconfig
```kconfig
if TARGET_ODROID_XU3

config SYS_BOARD
	default "odroid-xu3"

config SYS_VENDOR
	default "samsung"

config SYS_CONFIG_NAME
	default "odroid_xu3"

endif
```

## board/samsung/tm2/Kconfig
```kconfig
if TARGET_TM2

config SYS_BOARD
	default "tm2"

config SYS_VENDOR
	default "samsung"

config SYS_SOC
	default "exynos5433"

config SYS_CONFIG_NAME
	default "tm2"

endif
```

## configs/samsung_draco_defconfig
```kconfig
CONFIG_ARM=y
CONFIG_TARGET_SAMSUNG_DRACO=y
CONFIG_SYS_MALLOC_F_LEN=0x2000
CONFIG_FIT=y
CONFIG_HUSH_PARSER=y
CONFIG_DEFAULT_DEVICE_TREE="exynos5433-draco"
CONFIG_DMA_ADDR_T_64BIT=y
# CONFIG_CMD_BDI is not set
# CONFIG_CMD_CONSOLE is not set
# CONFIG_CMD_ELF is not set
# CONFIG_CMD_GO is not set
# CONFIG_CMD_IMLS is not set
# CONFIG_CMD_EXPORTENV is not set
# CONFIG_CMD_IMPORTENV is not set
# CONFIG_CMD_EDITENV is not set
# CONFIG_CMD_SAVEENV is not set
# CONFIG_CMD_ENV_EXISTS is not set
# CONFIG_CMD_LOADB is not set
# CONFIG_CMD_LOADS is not set
# CONFIG_CMD_FLASH is not set
# CONFIG_CMD_FPGA is not set
# CONFIG_CMD_SOURCE is not set
# CONFIG_CMD_SETEXPR is not set
# CONFIG_CMD_NET is not set
# CONFIG_CMD_NFS is not set
# CONFIG_DM_DEVICE_REMOVE is not set
# CONFIG_DISK is not set
```

## configs/tizen_defconfig
```kconfig
CONFIG_ARM=y
CONFIG_ARCH_EXYNOS=y
CONFIG_TARGET_TIZEN=y
CONFIG_OF_CONTROL=y
CONFIG_DEFAULT_DEVICE_TREE="exynos4412-odroid"
# CONFIG_SYS_MALLOC_CLEAR_ON_INIT is not set
CONFIG_SYS_PROMPT="U-Boot # "
# CONFIG_DM_I2C is not set
# CONFIG_CMD_IMLS is not set
# CONFIG_CMD_XIMG is not set
# CONFIG_CMD_FPGA is not set
# CONFIG_CMD_NFS is not set
# CONFIG_CMD_MISC is not set
CONFIG_USB=y
CONFIG_DM_USB=y
```
